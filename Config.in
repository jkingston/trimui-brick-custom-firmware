## Config.in
```kconfig
source "$BR2_EXTERNAL_BRICK_UI_PATH/package/zig-bin/Config.in"
source "$BR2_EXTERNAL_BRICK_UI_PATH/package/retroarch/Config.in"
source "$BR2_EXTERNAL_BRICK_UI_PATH/package/libretro-fceumm/Config.in"
source "$BR2_EXTERNAL_BRICK_UI_PATH/package/libretro-mgba/Config.in"
source "$BR2_EXTERNAL_BRICK_UI_PATH/package/libretro-genesis-plus-gx/Config.in"
source "$BR2_EXTERNAL_BRICK_UI_PATH/package/libretro-snes9x/Config.in"
source "$BR2_EXTERNAL_BRICK_UI_PATH/package/libretro-pcsx-rearmed/Config.in"
source "$BR2_EXTERNAL_BRICK_UI_PATH/package/libretro-fbneo/Config.in"
source "$BR2_EXTERNAL_BRICK_UI_PATH/package/libretro-beetle-ngp/Config.in"
source "$BR2_EXTERNAL_BRICK_UI_PATH/package/brick-shell/Config.in"
```

## package/brick-cartridge-models/Config.in
```kconfig
config BR2_PACKAGE_BRICK_CARTRIDGE_MODELS
	bool "Brick cartridge models"
	help
	  Install the neutral runtime cartridge and optical-disc models used by
	  the Brick game library. Per-game artwork remains on the data card.
```

## package/brick-shell/Config.in
```kconfig
config BR2_PACKAGE_BRICK_SHELL
	bool "Brick product shell"
	depends on BR2_aarch64
	depends on BR2_USE_MMU
	depends on !BR2_STATIC_LIBS
	depends on BR2_INSTALL_LIBSTDCPP
	select BR2_PACKAGE_HOST_ZIG_BIN
	select BR2_PACKAGE_RETROARCH
	select BR2_PACKAGE_LIBRETRO_FCEUMM
	select BR2_PACKAGE_LIBRETRO_MGBA
	select BR2_PACKAGE_LIBRETRO_GENESIS_PLUS_GX
	select BR2_PACKAGE_LIBRETRO_SNES9X
	select BR2_PACKAGE_LIBRETRO_PCSX_REARMED
	select BR2_PACKAGE_LIBRETRO_FBNEO
	select BR2_PACKAGE_LIBRETRO_BEETLE_NGP
	help
	  Install the event-driven Brick user interface and product boot splash.
```

## package/libretro-beetle-ngp/Config.in
```kconfig
config BR2_PACKAGE_LIBRETRO_BEETLE_NGP
	bool "beetle-ngp libretro core"
	depends on BR2_USE_MMU
	depends on !BR2_STATIC_LIBS
	depends on BR2_INSTALL_LIBSTDCPP
	help
	  Build the beetle-ngp emulator as a libretro core.
```

## package/libretro-fbneo/Config.in
```kconfig
config BR2_PACKAGE_LIBRETRO_FBNEO
	bool "fbneo libretro core"
	depends on BR2_USE_MMU
	depends on !BR2_STATIC_LIBS
	depends on BR2_INSTALL_LIBSTDCPP
	select BR2_PACKAGE_ZLIB
	help
	  Build the fbneo emulator as a libretro core.
```

## package/libretro-fceumm/Config.in
```kconfig
config BR2_PACKAGE_LIBRETRO_FCEUMM
	bool "FCEUmm libretro core"
	depends on BR2_USE_MMU
	depends on !BR2_STATIC_LIBS
	select BR2_PACKAGE_RETROARCH
	help
	  FCEUmm NES/Famicom emulator core for RetroArch.

comment "FCEUmm needs an MMU and a dynamic library toolchain"
	depends on !BR2_USE_MMU || BR2_STATIC_LIBS
```

## package/libretro-genesis-plus-gx/Config.in
```kconfig
config BR2_PACKAGE_LIBRETRO_GENESIS_PLUS_GX
	bool "Genesis Plus GX libretro core"
	depends on BR2_USE_MMU
	depends on !BR2_STATIC_LIBS
	select BR2_PACKAGE_RETROARCH
	help
	  Sega SG-1000, Master System, Game Gear and Mega Drive emulator core.

comment "Genesis Plus GX needs an MMU and a dynamic library toolchain"
	depends on !BR2_USE_MMU || BR2_STATIC_LIBS
```

## package/libretro-mgba/Config.in
```kconfig
config BR2_PACKAGE_LIBRETRO_MGBA
	bool "mGBA libretro core"
	depends on BR2_USE_MMU
	depends on !BR2_STATIC_LIBS
	select BR2_PACKAGE_RETROARCH
	help
	  mGBA Game Boy, Game Boy Color and Game Boy Advance emulator core.

comment "mGBA needs an MMU and a dynamic library toolchain"
	depends on !BR2_USE_MMU || BR2_STATIC_LIBS
```

## package/libretro-pcsx-rearmed/Config.in
```kconfig
config BR2_PACKAGE_LIBRETRO_PCSX_REARMED
	bool "pcsx-rearmed libretro core"
	depends on BR2_USE_MMU
	depends on !BR2_STATIC_LIBS
	depends on BR2_INSTALL_LIBSTDCPP
	help
	  Build the pcsx-rearmed emulator as a libretro core.
```

## package/libretro-snes9x/Config.in
```kconfig
config BR2_PACKAGE_LIBRETRO_SNES9X
	bool "snes9x libretro core"
	depends on BR2_USE_MMU
	depends on !BR2_STATIC_LIBS
	depends on BR2_INSTALL_LIBSTDCPP
	help
	  Build the snes9x emulator as a libretro core.
```

## package/retroarch/Config.in
```kconfig
config BR2_PACKAGE_RETROARCH
	bool "RetroArch"
	depends on BR2_USE_MMU
	depends on BR2_TOOLCHAIN_HAS_THREADS
	depends on !BR2_STATIC_LIBS
	select BR2_PACKAGE_ALSA_LIB
	select BR2_PACKAGE_LIBDRM
	select BR2_PACKAGE_LIBUDEV_ZERO
	help
	  Minimal RetroArch frontend using plain DRM, ALSA and evdev/udev.

comment "RetroArch needs an MMU, threads and a dynamic library toolchain"
	depends on !BR2_USE_MMU || !BR2_TOOLCHAIN_HAS_THREADS || BR2_STATIC_LIBS
```
