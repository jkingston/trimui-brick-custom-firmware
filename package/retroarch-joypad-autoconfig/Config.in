## package/retroarch-joypad-autoconfig/Config.in
```kconfig
config BR2_PACKAGE_RETROARCH_JOYPAD_AUTOCONFIG
	bool "RetroArch joypad autoconfiguration profiles"
	help
	  Official udev controller profiles used for hotplugged gamepads.
```
